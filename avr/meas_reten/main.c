#include <avr/io.h>
#include <avr/interrupt.h>
#include <avr/power.h>
#include <avr/eeprom.h>
#include <avr/pgmspace.h>
#include <util/delay.h>
#include <util/atomic.h>
#include "hw.h"
#include "scheduler.h"
#include "comm.h"

static volatile uint32_t flow_pulses;
static volatile uint32_t distance_avg;
static volatile uint32_t distance_err;
static uint16_t last_distance;

#define DIST_FILTER(x) (x >> 6)
#define abs(__x) ((__x > 0) ? (__x) : -(__x))

static const uint16_t tbl_litres[] PROGMEM = {
    2554, 2552, 2551, 2549, 2548, 2546, 2545, 2543, 2542, 2540, 2539, 2537, 2536, 2534, 2533, 2531, 2530,
    2528, 2527, 2525, 2524, 2522, 2521, 2519, 2518, 2516, 2514, 2513, 2511, 2510, 2508, 2507, 2505, 2504,
    2502, 2500, 2499, 2497, 2496, 2494, 2492, 2491, 2489, 2488, 2486, 2484, 2483, 2481, 2479, 2478, 2476,
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    38, 37, 35, 33, 32, 30, 28, 27, 25, 23, 22, 20, 19, 17, 15, 14, 12, 11, 9, 7, 6, 4, 3, 1, 0
};


ISR(TIMER1_COMPA_vect)
{
    TickCounter++;
}


ISR(PCINT0_vect)
{
    // flow sensor
    if (flow_in()) flow_pulses++;
}


ISR(TIMER2_COMPA_vect)
{
    uint8_t sample = dist_uart_in();
    static uint8_t bits;
    static uint32_t recv1, recv2;

    if (bits <= 8) {
        recv1 >>= 1;
        if (sample) recv1 |= 0x00000100;
        bits++;
    }
    else if (bits <= 38) {
        recv2 >>= 1;
        if (sample) recv2 |= 0x20000000;
        bits++;
    }

    if (bits == 39) {
        TCCR2B = 0; // stop
        if (recv1 == 0x1FF) {
            uint8_t data[3];
            data[0] = recv2 >> 1;
            data[1] = recv2 >> 11;
            data[2] = recv2 >> 21;

            if ((((uint16_t)0xFF + data[0] + data[1]) & 0xFF) == data[2]) {
                uint16_t distance_new = (data[0] << 8) + data[1];
                int16_t error = distance_new - DIST_FILTER(distance_avg);

                distance_avg -= DIST_FILTER(distance_avg);
                distance_avg += distance_new;
                distance_err -= DIST_FILTER(distance_err);
                distance_err += abs(error);

                ResetDelay(&last_distance);
            }
        } else {
            _delay_ms(5); // not in sync - blocking wait
        }
        recv1 = 0;
        recv2 = 0;
        bits = 0;
        PCIFR = _BV(PCIF1);
        PCICR |= _BV(PCIE1);
    }
}


ISR(PCINT1_vect)
{
    // UART z merice vzdalenosti, mirne prasacke, ale funkcni reseni
    PCICR &= ~_BV(PCIE1);
    TCNT2 = 0;
    _delay_us(8);
    TCCR2B = _BV(CS20);
}


void comm_execute(uint8_t cmd, uint16_t value)
{
    uint32_t flow_pulses_cpy;
    uint16_t distance_avg_cpy, distance_err_cpy;
    ATOMIC_BLOCK(ATOMIC_RESTORESTATE) {
        flow_pulses_cpy = flow_pulses;
        if (HasDelayElapsed(1000, &last_distance, false)) {
            distance_avg_cpy = 65535;
            distance_err_cpy = 65535;
        } else {
            distance_avg_cpy = DIST_FILTER(distance_avg);
            distance_err_cpy = DIST_FILTER(distance_err);
        }
    }

    switch (cmd) {
        case GET_PULSES_LO:
            comm_send(ADDR_RESP_ID, GET_PULSES_LO, (flow_pulses_cpy));
            break;
        case GET_PULSES_HI:
            comm_send(ADDR_RESP_ID, GET_PULSES_HI, (flow_pulses_cpy >> 16));
            break;
        case GET_LITRES:
            comm_send(ADDR_RESP_ID, GET_LITRES, flow_pulses_cpy / eeprom_read_word(ADDR_PULSES_L));
            break;
        case RESET_FLOW:
            ATOMIC_BLOCK(ATOMIC_RESTORESTATE) {
                flow_pulses = 0;
            }
            break;

        case GET_DIST:
            if (distance_avg_cpy > 2047) distance_avg_cpy = 2047;
            if (distance_err_cpy > 31) distance_err_cpy = 31;
            comm_send(ADDR_RESP_ID, GET_DIST, distance_avg_cpy | (distance_err_cpy << 11));
            break;
        case GET_OCCUP:
            if (distance_avg_cpy < 265) distance_avg_cpy = 265;
            if (distance_avg_cpy > 1414) distance_avg_cpy = 1414;
            uint16_t litres = pgm_read_word(&tbl_litres[distance_avg_cpy - 265]);
            comm_send(ADDR_RESP_ID, GET_OCCUP, litres);
            break;

        case SET_PULSES_L:
            eeprom_write_word(ADDR_PULSES_L, value);
            break;
        case GET_PULSES_L:
            comm_send(ADDR_RESP_ID, GET_PULSES_L, eeprom_read_word(ADDR_PULSES_L));
            break;
    }
}


int main(void)
{
    clock_prescale_set(clock_div_8);

    // timer pro soft prijem UARTu
    OCR2A = (uint8_t)(F_CPU/9600)-1;
    TCCR2A = _BV(WGM21);
    TCCR2B = 0; /* _BV(CS20) */
    TIMSK2 |= _BV(OCIE2A);

    PCMSK0 |= _BV(PCINT1); // flow sensor
    PCMSK1 |= _BV(PCINT10); // UART z merice vzdalenosti
    PCICR |= _BV(PCIE0) | _BV(PCIE1);

    comm_init();

    OCR1A = (uint16_t)(F_CPU/8*0.001)-1;
    TCCR1B |= _BV(CS11) | _BV(WGM12);
    TIMSK1 |= _BV(OCIE1A);
    sei();

    // nastaveni vychozi hodnoty pulsu na litr
    if (eeprom_read_word(ADDR_PULSES_L) == UINT16_MAX) {
        eeprom_write_word(ADDR_PULSES_L, 405); // 4049 pulsu = 10 litru
    }

    while (1) {
        // obsluha komunikace
        comm_task();

        // vse ostatni v ISR

    }
}
